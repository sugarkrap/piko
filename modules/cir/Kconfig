## modules/cir/Kconfig
```kconfig
config IR_PIKO_CIR
	tristate "piko consumer IR (Zaurus IrDA transceiver)"
	depends on RC_CORE && PXA25x
	help
	  Drives the Sharp Zaurus IrDA transceiver as a 38 kHz consumer
	  infrared port, so the device can read remote controls and act
	  as one. Transmit bit-bangs the transceiver's TXD pin; receive
	  demodulates the carrier in software off an edge interrupt on
	  RXD. Mutually exclusive with pxaficp_ir, which owns the same
	  pins and the same transceiver.

	  To compile this driver as a module, choose M here: the module
	  will be called piko-cir.
```

## modules/irda/drivers/Kconfig
```kconfig
menu "Infrared-port device drivers"
	depends on IRDA != n

config PXA_FICP
	tristate "Intel PXA2xx Internal FICP"
	depends on ARCH_PXA && IRDA
	help
	  Say Y or M here if you want to build support for the PXA2xx
	  built-in IRDA interface which can support both SIR and FIR.
	  This driver relies on platform specific helper routines so
	  available capabilities may vary from one PXA2xx target to
	  another.

endmenu
```
